## firmware/main/Kconfig.projbuild
```kconfig
menu "Security Camera Configuration"

    menu "Device Identity"
        config BOARD_TYPE
            string "Board type identifier"
            default "esp32cam"
            help
                Short board name baked into the device ID. Examples:
                "esp32cam", "esp32s3-freenove", "esp32cam-pir".

                The full device ID assembled at boot is:
                    <board>-<mac6>-<fwver>
                e.g. "esp32cam-a1b2c3-0.2.0", where mac6 is the last
                3 bytes of the factory eFuse MAC and fwver comes from
                PROJECT_VER in CMakeLists.txt.
    endmenu

    menu "WiFi"
        config WIFI_SSID
            string "WiFi SSID"
            default "myssid"
            help
                SSID of the WiFi network to connect to.

        config WIFI_PASSWORD
            string "WiFi Password"
            default "mypassword"
            help
                Password for the WiFi network.

        config WIFI_MAX_RETRIES
            int "Maximum connection retries"
            default 5
            range 1 20
    endmenu

    menu "HTTP Endpoint"
        config HTTP_ENDPOINT_URL
            string "Remote HTTP endpoint base URL"
            default "http://192.168.1.100:8080/upload"
            help
                Base URL for the server upload endpoint. The camera ID is
                appended automatically: <url>/<camera_id>.

        config HTTP_TIMEOUT_MS
            int "HTTP request timeout (ms)"
            default 10000
            range 1000 60000

        config HTTP_BASIC_AUTH_ENABLE
            bool "Enable HTTP Basic Authentication"
            default y

        config HTTP_BASIC_AUTH_USERNAME
            string "Username"
            default "camera"
            depends on HTTP_BASIC_AUTH_ENABLE

        config HTTP_BASIC_AUTH_PASSWORD
            string "Password"
            default "changeme"
            depends on HTTP_BASIC_AUTH_ENABLE
    endmenu

    menu "OTA Updates"
        config OTA_ENABLE
            bool "Enable OTA firmware updates on boot"
            default y

        config OTA_FIRMWARE_URL
            string "Firmware base URL"
            default "changeme"
            depends on OTA_ENABLE
            help
                Base URL of the firmware directory. The device tries to GET:
                  <url>/<board>_v<N+1>.bin
                where N is the running version (integer). If 200 → update.
                If 404 → up to date. Server just hosts all versioned binaries.

                Board type is set under Device Identity → Board type identifier.

        config OTA_BASIC_AUTH_ENABLE
            bool "Enable HTTP Basic Authentication for OTA endpoints"
            default y
            depends on OTA_ENABLE

        config OTA_BASIC_AUTH_USERNAME
            string "Username"
            default "camera"
            depends on OTA_BASIC_AUTH_ENABLE

        config OTA_BASIC_AUTH_PASSWORD
            string "Password"
            default "camera"
            depends on OTA_BASIC_AUTH_ENABLE
    endmenu

    menu "Capture"
        config JPEG_QUALITY
            int "JPEG quality (lower = better, higher compression)"
            default 10
            range 4 63

        config FRAME_SIZE
            int "Frame size (framesize_t enum value)"
            default 9
            range 0 13
            help
                Camera capture resolution as framesize_t index.
                0=96x96, 1=QQVGA 160x120, 5=QVGA 320x240,
                8=VGA 640x480, 9=SVGA 800x600 (default),
                10=XGA 1024x768, 12=SXGA 1280x1024, 13=UXGA 1600x1200
    endmenu

    menu "Camera Pins (per-board values live in sdkconfig.defaults.<board>)"
        config CAM_PIN_PWDN
            int "PWDN pin (-1 if unused)"
            default 32

        config CAM_PIN_RESET
            int "RESET pin (-1 if unused)"
            default -1

        config CAM_PIN_XCLK
            int "XCLK pin"
            default 0

        config CAM_PIN_SIOD
            int "SIOD (SDA) pin"
            default 26

        config CAM_PIN_SIOC
            int "SIOC (SCL) pin"
            default 27

        config CAM_PIN_D7
            int "D7 pin"
            default 35

        config CAM_PIN_D6
            int "D6 pin"
            default 34

        config CAM_PIN_D5
            int "D5 pin"
            default 39

        config CAM_PIN_D4
            int "D4 pin"
            default 36

        config CAM_PIN_D3
            int "D3 pin"
            default 21

        config CAM_PIN_D2
            int "D2 pin"
            default 19

        config CAM_PIN_D1
            int "D1 pin"
            default 18

        config CAM_PIN_D0
            int "D0 pin"
            default 5

        config CAM_PIN_VSYNC
            int "VSYNC pin"
            default 25

        config CAM_PIN_HREF
            int "HREF pin"
            default 23

        config CAM_PIN_PCLK
            int "PCLK pin"
            default 22
    endmenu

endmenu
```

## firmware/sdkconfig.defaults
```kconfig
# Shared settings for all boards. Board-specific config (target, flash,
# PSRAM, camera pins, partition table) lives in sdkconfig.defaults.<board>.
# Build with: idf.py @boards/<board>.args build

# Max CPU clock
CONFIG_ESP_DEFAULT_CPU_FREQ_MHZ_240=y

# Increase main task stack for HTTP + camera ops
CONFIG_ESP_MAIN_TASK_STACK_SIZE=8192

# HTTP client + TLS
CONFIG_ESP_HTTP_CLIENT_ENABLE_HTTPS=y
CONFIG_MBEDTLS_CERTIFICATE_BUNDLE=y
CONFIG_MBEDTLS_CERTIFICATE_BUNDLE_DEFAULT_FULL=y
# Allocate TLS I/O buffers on demand and size them to the actual records
# instead of a fixed 16 KB each — keeps HTTPS affordable on the RAM-tight
# original ESP32. Deliberately NOT freeing the CA/config data after the
# handshake (MBEDTLS_DYNAMIC_FREE_CONFIG_DATA): the upload stream reconnects
# on failure, and freeing would require re-registering the cert each time.
CONFIG_MBEDTLS_DYNAMIC_BUFFER=y

# WiFi
CONFIG_ESP_WIFI_STATIC_RX_BUFFER_NUM=4
CONFIG_ESP_WIFI_DYNAMIC_RX_BUFFER_NUM=8

# TCP buffers sized so a whole JPEG frame (~30-45 KB) fits in the send buffer;
# with the 5760 B default a frame needs ~7 window round-trips over the WAN path
CONFIG_LWIP_TCP_SND_BUF_DEFAULT=65534
CONFIG_LWIP_TCP_WND_DEFAULT=32768
CONFIG_LWIP_TCP_RECVMBOX_SIZE=32

# Custom partition table (per-board CSV set in sdkconfig.defaults.<board>)
CONFIG_PARTITION_TABLE_CUSTOM=y
CONFIG_PARTITION_TABLE_OFFSET=0x8000
```

## firmware/sdkconfig.defaults.esp32cam
```kconfig
# AI-Thinker-pinout ESP32-CAM (original ESP32, USB-C carrier, OV2640, PSRAM64H)
CONFIG_IDF_TARGET="esp32"
CONFIG_BOARD_TYPE="esp32cam"

# SXGA 1280x1024, matching the S3 board. OV2640 sensor output caps at
# 15 fps above SVGA; drop back to 9 (SVGA) if the fps cost is too high.
CONFIG_FRAME_SIZE=12
CONFIG_JPEG_QUALITY=10

# 4 MB flash @ 80 MHz
CONFIG_ESPTOOLPY_FLASHSIZE_4MB=y
CONFIG_ESPTOOLPY_FLASHFREQ_80M=y

# Quad PSRAM @ 80 MHz (requires 80 MHz flash)
CONFIG_ESP32_SPIRAM_SUPPORT=y
CONFIG_SPIRAM=y
CONFIG_SPIRAM_SPEED_80M=y
CONFIG_SPIRAM_BOOT_INIT=y

CONFIG_PARTITION_TABLE_CUSTOM_FILENAME="partitions_esp32cam.csv"

# Camera pins
CONFIG_CAM_PIN_PWDN=32
CONFIG_CAM_PIN_RESET=-1
CONFIG_CAM_PIN_XCLK=0
CONFIG_CAM_PIN_SIOD=26
CONFIG_CAM_PIN_SIOC=27
CONFIG_CAM_PIN_D7=35
CONFIG_CAM_PIN_D6=34
CONFIG_CAM_PIN_D5=39
CONFIG_CAM_PIN_D4=36
CONFIG_CAM_PIN_D3=21
CONFIG_CAM_PIN_D2=19
CONFIG_CAM_PIN_D1=18
CONFIG_CAM_PIN_D0=5
CONFIG_CAM_PIN_VSYNC=25
CONFIG_CAM_PIN_HREF=23
CONFIG_CAM_PIN_PCLK=22
```

## firmware/sdkconfig.defaults.esp32s3
```kconfig
# Freenove ESP32-S3-WROOM (16 MB flash, 8 MB OPI PSRAM)
# Fitted with an OV2640 — the OV5640 overheats on this board.
CONFIG_IDF_TARGET="esp32s3"
CONFIG_BOARD_TYPE="esp32s3-freenove"

# Higher capture quality than the base esp32cam: SXGA 1280x1024 (frame_size
# 12). OV2640 sensor output caps at 15 fps above SVGA, and frames are ~2x
# the bytes — drop to 10 (XGA) if fps matters more than detail.
CONFIG_FRAME_SIZE=12
CONFIG_JPEG_QUALITY=10

# 16 MB flash (S3 flash clock already defaults to 80 MHz)
CONFIG_ESPTOOLPY_FLASHSIZE_16MB=y

# 8 MB OPI PSRAM @ 80 MHz
CONFIG_SPIRAM=y
CONFIG_SPIRAM_MODE_OCT=y
CONFIG_SPIRAM_SPEED_80M=y
CONFIG_SPIRAM_BOOT_INIT=y

CONFIG_PARTITION_TABLE_CUSTOM_FILENAME="partitions_esp32s3.csv"

# Camera pins
CONFIG_CAM_PIN_PWDN=-1
CONFIG_CAM_PIN_RESET=-1
CONFIG_CAM_PIN_XCLK=15
CONFIG_CAM_PIN_SIOD=4
CONFIG_CAM_PIN_SIOC=5
CONFIG_CAM_PIN_D7=16
CONFIG_CAM_PIN_D6=17
CONFIG_CAM_PIN_D5=18
CONFIG_CAM_PIN_D4=12
CONFIG_CAM_PIN_D3=10
CONFIG_CAM_PIN_D2=8
CONFIG_CAM_PIN_D1=9
CONFIG_CAM_PIN_D0=11
CONFIG_CAM_PIN_VSYNC=6
CONFIG_CAM_PIN_HREF=7
CONFIG_CAM_PIN_PCLK=13
```
